## sdkconfig.defaults
```kconfig
# PERSIST SIZE OPTIMIZATION OVER DEBUG
CONFIG_COMPILER_OPTIMIZATION_SIZE=y
CONFIG_COMPILER_OPTIMIZATION_DEBUG=n
CONFIG_OPTIMIZATION_LEVEL_RELEASE=y
CONFIG_COMPILER_OPTIMIZATION_LEVEL_RELEASE=y

# FLASH SIZE 4MB
CONFIG_ESPTOOLPY_FLASHSIZE_4MB=y

# CUSTOM PARTITIONS TABLE
CONFIG_PARTITION_TABLE_CUSTOM=y
CONFIG_PARTITION_TABLE_CUSTOM_FILENAME="partitions.csv"
CONFIG_PARTITION_TABLE_FILENAME="partitions.csv"
```
